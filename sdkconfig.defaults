## sdkconfig.defaults
```kconfig
# fix for build issue
CONFIG_FREERTOS_HZ=1000

# Enable BLE with NimBLE stack
CONFIG_BT_ENABLED=y
CONFIG_BT_NIMBLE_ENABLED=y
CONFIG_BT_NIMBLE_MAX_CONNECTIONS=1
CONFIG_BT_NIMBLE_SVC_GAP_DEVICE_NAME="CyberDeck_Spotify"
```
